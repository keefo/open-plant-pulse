## sensor/firmware/main/Kconfig.projbuild
```kconfig
menu "Open Plant Pulse"

config OPP_PRODUCTION_LIFECYCLE
    bool "Enable bounded BTHome advertise/deep-sleep lifecycle"
    default n
    help
        Run one SHT45 acquisition, advertise the fresh sample for a bounded
        window, stop Bluetooth, and enter timer deep sleep. This production
        mode bypasses the powered development web console and SNTP tasks.

config OPP_BTHOME_ADVERTISEMENT_WINDOW_MS
    int "BTHome advertising window in milliseconds"
    range 500 30000
    default 3000

config OPP_BTHOME_ADVERTISEMENT_INTERVAL_MS
    int "BTHome advertising interval in milliseconds"
    range 100 1000
    default 250

config OPP_DEVELOPMENT_ADVERTISEMENT_INTERVAL_MS
    int "Advertising interval while always awake, in milliseconds"
    depends on !OPP_PRODUCTION_LIFECYCLE
    range 20 1000
    default 50
    help
        The always-awake firmware advertises this often. A scanner catches
        only some advertisements, and each report alternates two packets, so
        at 250 ms a Mac often missed a report's main packet before the next
        report replaced it. At 50 ms each packet goes out about ten times a
        second. The radio cost is small beside Wi-Fi; the production cycle
        keeps OPP_BTHOME_ADVERTISEMENT_INTERVAL_MS.

config OPP_WEB_UI_ENABLED
    bool "Enable Wi-Fi web diagnostics"
    default y
    help
        Join a Wi-Fi network and serve a webpage that mirrors ESP logs.
        Disable this for battery-powered deployments.

config OPP_CLOCK_SYNC_ENABLED
    bool "Enable SNTP clock synchronization"
    default y
    help
        Validate the wall clock and synchronize it over Wi-Fi when invalid or
        stale. The retained RTC clock continues across deep sleep but not loss
        of power.

if OPP_WEB_UI_ENABLED || OPP_CLOCK_SYNC_ENABLED

config OPP_WIFI_SSID
    string "Wi-Fi SSID"
    default ""

config OPP_WIFI_PASSWORD
    string "Wi-Fi password"
    default ""
    help
        Stored only in the generated, git-ignored sdkconfig file.

endif

if OPP_CLOCK_SYNC_ENABLED

config OPP_SNTP_SERVER
    string "SNTP server"
    default "pool.ntp.org"

config OPP_CLOCK_SYNC_TIMEOUT_SECONDS
    int "SNTP synchronization timeout in seconds"
    range 3 60
    default 15

config OPP_CLOCK_WIFI_WINDOW_SECONDS
    int "Clock-only Wi-Fi window in seconds"
    range 5 120
    default 30
    help
        Total time Wi-Fi may remain active for clock synchronization when the
        development web UI is disabled. This bounds connection and SNTP time.

config OPP_CLOCK_SYNC_RETRY_MINUTES
    int "Failed synchronization retry delay in minutes"
    range 1 1440
    default 15

config OPP_CLOCK_RESYNC_INTERVAL_HOURS
    int "Clock drift correction interval in hours"
    range 6 24
    default 12

config OPP_CLOCK_JUMP_WARNING_SECONDS
    int "Clock correction warning threshold in seconds"
    range 1 3600
    default 300

endif

config OPP_SHT45_SDA_GPIO
    int "SHT45 SDA GPIO"
    range 0 21
    default 3
    help
        I2C data pin. GPIO3 is D1 on the Seeed Studio XIAO ESP32-C3. The SHT45
        shares this bus with the INA219. D4 and D5 are taken by the RS485
        board's UART, whose receiver drives the line and would corrupt I2C.

config OPP_SHT45_SCL_GPIO
    int "SHT45 SCL GPIO"
    range 0 21
    default 5
    help
        I2C clock pin. GPIO5 is D3 on the Seeed Studio XIAO ESP32-C3.

config OPP_SHT45_SAMPLE_INTERVAL_SECONDS
    int "SHT45 bench sampling interval in seconds"
    range 1 3600
    default 5
    help
        Interval between one-shot SHT45 measurements while the development
        firmware remains awake. Production deep-sleep sampling will use the
        sensor-node sampling interval instead.

config OPP_SENSOR_MODBUS_ADDRESS
    int "Sensor Modbus address"
    range 1 247
    default 1

config OPP_REPORT_QUEUE_CAPACITY
    int "Reports kept for the hub"
    range 4 64
    default 32
    help
        How many reports a sensor that belongs to a hub keeps until the hub
        acknowledges them: at a 30-minute interval, 32 covers 16 hours without
        a hub. Each takes about 60 bytes of the 24 KB NVS partition, which also
        holds the bond, configuration and Wi-Fi credentials. When it is full
        the sensor makes no new reports rather than overwrite one.

config OPP_BATTERY_MONITOR_ENABLED
    bool "Monitor the battery with an INA219"
    default y
    help
        Read pack voltage and current from an INA219 on the shared I2C bus and
        estimate the state of charge and remaining runtime.

if OPP_BATTERY_MONITOR_ENABLED

config OPP_INA219_ADDRESS
    int "INA219 I2C address"
    range 64 79
    default 64
    help
        64 is 0x40, with A0 and A1 open. Do not bridge A1 alone: 0x44 is the
        SHT45.

config OPP_INA219_SHUNT_MILLIOHMS
    int "INA219 shunt resistance in milliohms"
    range 1 1000
    default 100
    help
        100 is the R100 (0.1 ohm) shunt most INA219 modules carry, giving
        0.1 mA resolution up to about 3.2 A. Read the marking on your module.

config OPP_INA219_POSITIVE_IS_CHARGING
    bool "Positive shunt current means the pack is charging"
    default y
    help
        True when VIN+ is on the system node and VIN- on the pack, as on the
        assembled node: current into the pack then flows VIN+ to VIN-.

config OPP_BATTERY_CAPACITY_MAH
    int "Pack capacity in mAh"
    range 100 20000
    default 5000
    help
        The combined rated capacity of the cells in parallel, for example
        5000 for two 2500 mAh cells. Used for the charge count and runtime.

config OPP_BATTERY_SAMPLE_INTERVAL_MS
    int "Battery sampling interval in milliseconds"
    range 250 60000
    default 1000

endif

config OPP_ALWAYS_REACHABLE
    bool "Stay reachable over Bluetooth continuously"
    depends on !OPP_PRODUCTION_LIFECYCLE
    default y
    help
        Keep re-advertising between reports even on battery, so the hub can
        deliver a firmware update or settings change at any time instead of
        waiting for the next report. For bench development; it keeps the
        Bluetooth radio busy. Disable it to measure the battery-saving
        behaviour, where an owned sensor on battery is reachable only at its
        reports, while USB is attached, and for two minutes after a hub
        connection.

config OPP_SOIL_PROBE_ENABLED
    bool "Read the RS485 soil probe"
    default y
    help
        Poll a ComWinTop NPKPHCTH-S (NPK-type, five-needle) probe over Modbus
        RTU and report its moisture, temperature and conductivity.

if OPP_SOIL_PROBE_ENABLED

config OPP_SOIL_PROBE_TX_GPIO
    int "RS485 UART TX GPIO"
    range 0 21
    default 6
    help
        GPIO6 is D4, wired to the XIAO RS485 board's transceiver input.

config OPP_SOIL_PROBE_RX_GPIO
    int "RS485 UART RX GPIO"
    range 0 21
    default 7
    help
        GPIO7 is D5, wired to the XIAO RS485 board's transceiver output.

config OPP_SOIL_PROBE_DE_GPIO
    int "RS485 driver-enable GPIO"
    range 0 21
    default 4
    help
        GPIO4 is D2, the RS485 board's driver-enable. The UART drives it high
        while transmitting.

config OPP_SOIL_PROBE_POWER_GPIO
    int "Probe power switch GPIO (-1 for none)"
    range -1 21
    default 10
    help
        GPIO10 is D10, driving the gate of an AO3400 N-MOSFET between the
        MT3608's input ground and system ground: high powers the MT3608 and
        probe, low cuts both. A gate-to-source pull-down keeps the probe off
        through reset. Set -1 when the probe is powered permanently.

config OPP_SOIL_PROBE_WARMUP_MS
    int "Probe warm-up after power-on in milliseconds"
    range 0 60000
    default 5000
    help
        Wait this long after switching the probe on before the first read.
        The firmware logs how long the probe actually took to answer.

        Moisture, temperature and conductivity are right two seconds after
        power-on. pH is not there yet: until its first conversion finishes
        the probe answers 3.0, the floor of its range, and a reading taken
        at two seconds is that placeholder rather than a measurement.

        Measured 2026-10-12 against the probe in drainage water, three cold
        starts per point: 2 s gave 3.0 every time; 3 s gave 4.8; and 5, 6,
        8, 10, 15, 30 and 60 s all gave 4.7. The answer arrives between two
        and three seconds and does not move afterwards, so this is five for
        the margin rather than because the electrode is still settling.

config OPP_SOIL_PROBE_PH_WARMUP_MS
    int "Warm-up before the occasional pH reading in milliseconds"
    range 0 300000
    default 240000
    help
        The warm-up used for the deep reading that carries pH and NPK.

        ComWinTop give pH as plus or minus 0.3, and say it wants three to
        five minutes in soil to settle. That is not the electrode warming
        up -- in water it is settled inside five seconds -- it is the soil
        around the needles coming to equilibrium with it, and no shorter
        wait gets there.

        Four minutes of a 28.5 mA load twice a day is 3.8 mAh against a
        5000 mAh pack. The same wait on every wake would be 91 mAh a day,
        which is why pH has a reading of its own.

config OPP_SOIL_PROBE_PH_INTERVAL_SECONDS
    int "Seconds between deep pH readings"
    range 60 604800
    default 43200
    help
        Soil pH moves over weeks, so twice a day loses nothing and costs
        almost nothing. Readings in between carry moisture, temperature
        and conductivity only, and say so rather than repeating the last
        pH as though it had just been measured.

config OPP_SOIL_PROBE_PH_ON_WATERING_RISE
    int "Moisture rise in tenths of a percent that asks for a pH reading"
    range 0 1000
    default 150
    help
        A jump this large means the pot was watered, and watering is the one
        moment pH is worth measuring: new water, perhaps fertiliser, and
        whatever the pour did to the soil's chemistry. Zero switches this
        off and leaves pH to the clock alone.

        150 is 15.0 percentage points, which is what the hub already calls
        a watering, so the two agree about what happened.

config OPP_SOIL_PROBE_PH_SETTLE_SECONDS
    int "Seconds to wait after a watering before reading pH"
    range 0 86400
    default 0
    help
        How long to leave the pot alone after a watering before spending
        four minutes on pH. Zero reads straight away.

        Water poured on a pot is still finding its way down for a while,
        so a reading taken at once describes the pour as much as the soil.
        Reading immediately answers "what did I just put in", which is the
        question somebody standing over the plant is asking; the twice-daily
        readings give the settled picture either way.

config OPP_SOIL_PROBE_PH_MIN_INTERVAL_SECONDS
    int "Shortest gap between deep pH readings"
    range 0 86400
    default 900
    help
        A floor under how often the probe can be held on for four minutes.
        A moisture jump is not always a watering -- pushing the probe back
        into the pot looks exactly the same -- and without this a noisy
        afternoon could spend the battery on pH.

        Fifteen minutes rather than an hour, because a watering is supposed
        to be read at once and an hour would swallow one that followed soon
        after a scheduled reading. A rise only fires once per watering, so
        this guards against something going wrong rather than normal use.

config OPP_SOIL_PROBE_BAUD_RATE
    int "Soil probe baud rate"
    default 4800
    help
        The probe ships at 4800 baud, 8 data bits, no parity, one stop bit.

config OPP_SOIL_PROBE_SAMPLE_INTERVAL_SECONDS
    int "Soil probe bench sampling interval in seconds"
    range 1 3600
    default 10

endif

config OPP_SAMPLE_INTERVAL_MINUTES
    int "Sampling interval in minutes"
    range 5 1440
    default 30

endmenu
```

## sensors/hx711-scale/main/Kconfig.projbuild
```kconfig
menu "HX711 scale"

    choice SCALE_LINK
        prompt "How the scale talks to other devices"
        default SCALE_LINK_WIFI

        config SCALE_LINK_WIFI
            bool "Wi-Fi: web page and over-the-air updates"
        config SCALE_LINK_BLE
            bool "Bluetooth LE: Chrome page on the Mac (mac/scale.html)"
        config SCALE_LINK_USB
            bool "USB only, no radio: Chrome page on the Mac (mac/scale.html)"
    endchoice

    config SCALE_ZIGBEE
        bool "Also speak Zigbee, alongside Wi-Fi"
        depends on SCALE_LINK_WIFI
        default n
        help
            Joins a Zigbee coordinator and sends every reading to it, while
            keeping Wi-Fi up so the scale stays reachable for over-the-air
            updates. The two share one radio and take turns.

    config SCALE_ZIGBEE_MIN_GAP_SECONDS
        int "Floor on the gap between Zigbee reports, in seconds"
        depends on SCALE_ZIGBEE
        range 1 3600
        default 30
        help
            Zigbee reports at whatever the sampling interval is set to, so
            there is one rate to configure and it can be changed at runtime
            with "i <seconds>".

            This is only a guard for continuous mode, where the scale samples
            ten times a second for a live display: relaying all of that keeps
            the shared radio busy enough to push Wi-Fi off the air.

    config SCALE_ZIGBEE_CHANNEL
        int "Zigbee channel to look for the coordinator on"
        depends on SCALE_ZIGBEE
        range 0 26
        default 15
        help
            Must match the channel the coordinator formed its network on.
            Searching every channel instead keeps the shared radio busy long
            enough to stop Wi-Fi associating.

    config SCALE_HOME_WIFI_SSID
        string "Home Wi-Fi name to join on a first boot"
        default ""
        help
            Only a bootstrap. The Wi-Fi driver keeps whatever it last joined
            in NVS, and the scale uses that in preference, so this is read on
            a device that has never joined anything -- after a full erase, or
            the first time a board is flashed.

            Leave it empty and the scale starts its own network instead,
            HX711-Scale at 192.168.4.1, where POST /api/wifi can give it the
            household's. Set it in sdkconfig, which git ignores, and never in
            a source file: this repository is public.

    config SCALE_HOME_WIFI_PASS
        string "Password for that network"
        default ""

endmenu
```
